## arch/arm64/hotplug/Kconfig
```kconfig
config ALUCARD_HOTPLUG
	bool "Enable alucard-hotplug cpu hotplug driver"
	default y
	help
	Generic Alucard-hotplug cpu hotplug driver for ARM SOCs
	
config INTELLI_PLUG
 	bool "Hotplug for Razor Reborn"
 	depends on MSM_RUN_QUEUE_STATS
 	default y
 	help
 	  This enables kernel based multi core control.
```
